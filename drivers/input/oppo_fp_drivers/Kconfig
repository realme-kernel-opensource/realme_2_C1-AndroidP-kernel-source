## drivers/input/oppo_fp_drivers/Kconfig
```kconfig
config SILEAD_FP_PLATFORM
 bool "silead fingerprint Driver"
          default y
          help
            Say Y here if you have a silead fingerprint.
            If unsure, say N

source "drivers/input/oppo_fp_drivers/silead/Kconfig"

config FINGERPRINT_FPC_1020
         tristate "FPC Fingerprint"
         default y
         help
            FPC Fingerprint
source "drivers/input/oppo_fp_drivers/fpc1020/Kconfig
```

## drivers/input/oppo_fp_drivers/drivers/fpc1020/Kconfig
```kconfig
############################################################
## Copyright (C), 2008-2016, OPPO Mobile Comm Corp., Ltd.
## ODM_WT_EDIT
## File: - Kconfig
## Description: kernel fingerprint Kconfig.
##
## Version: v2.2.10-2018-03-05
## Date : 2018/06/26
##
## ------------------------------- Revision History: -------------------------------
##  	<author>		<data> 	   <version >	       <desc>
##	
##
#############################################################
config FINGERPRINT_FPC_1020
       tristate "FPC Fingerprint"
       default y
       help
          FPC Fingerprint
```

## drivers/input/oppo_fp_drivers/drivers/silead/Kconfig
```kconfig
#*******************************************************************************
# Copyright (C), 2008-2016, OPPO Mobile Comm Corp., Ltd.
# ODM_WT_EDIT
# FILE: - Kconfig
# Description : Novatek NT36xxx touchscreen driver configuration
# Version: 1.0
# Date : 2018/12/27
#
# -------------------------Revision History:----------------------------------
#  <author>	 <data> 	<version >			<desc>
#
#
#*******************************************************************************/
config SILEAD_FP_PLATFORM
	bool "silead host download SPI driver"
	default y
	help
	  Say Y here if you have a silead  fp 
	  to your system by SPI bus.

	  If unsure, say N.
```

## drivers/input/touchscreen/himax_hx83102d/Kconfig
```kconfig
#*******************************************************************************
# Copyright (C), 2008-2016, OPPO Mobile Comm Corp., Ltd.
# ODM_WT_EDIT
# FILE: - Kconfig
# Description : himax touchscreen driver configuration
# Version: 1.0
# Date : 2018/5/22
#
# -------------------------Revision History:----------------------------------
#  <author>	 <data> 	<version >			<desc>
#
#
#*******************************************************************************/
config TOUCHSCREEN_HIMAX_INCELL
	bool "himax host download SPI driver"
	default y
	help
	  Say Y here if you have a himax no flash touchscreen connected
	  to your system by SPI bus.

	  If unsure, say N.

config TOUCHSCREEN_HIMAX_IC_HX83102
	bool "himax host download SPI driver"
	default y
	help
	  Say Y here if you have a himax no flash touchscreen connected
	  to your system by SPI bus.

	  If unsure, say N.

config TOUCHSCREEN_HIMAX_COMMON
	bool "himax host download SPI driver"
	default y
	help
	  Say Y here if you have a himax no flash touchscreen connected
	  to your system by SPI bus.

	  If unsure, say N.

config TOUCHSCREEN_HIMAX_DEBUG
	bool "himax host download SPI driver"
	default y
	help
	  Say Y here if you have a himax no flash touchscreen connected
	  to your system by SPI bus.

	  If unsure, say N.

config TOUCHSCREEN_HIMAX_INSPECT
	bool "himax host download SPI driver"
	default y
	help
	  Say Y here if you have a himaxx no flash touchscreen connected
	  to your system by SPI bus.
```

## drivers/soc/oppo/oppo_phoenix/Kconfig
```kconfig
# ifdef VENDOR_EDIT
config PHOENIX_BASE
bool "config phoenix base"
help
    Provide base functions for phoenix.
#endif /* VENDOR_EDIT */
```
